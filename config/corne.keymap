// Copyright (c) 2022 The ZMK Contributors
// SPDX-License-Identifier: MIT

#define HOST_OS 1
#include "../fuckthis/helper.h"

#include <behaviors.dtsi>
#include <dt-bindings/zmk/keys.h>
#include <dt-bindings/zmk/bt.h>
#include <dt-bindings/zmk/outputs.h>
#include <dt-bindings/zmk/pointing.h>

// Home row mods macro
#define HRML(k1,k2,k3,k4) &ht LCTRL k1  &ht LALT k2  &ht LCTRL k3  &ht LGUI  k4
#define HRMR(k1,k2,k3,k4) &ht RGUI k1   &ht RCTRL k2  &ht RALT k3  &ht RCTRL k4
#define SS(k) LG(LS(k))
#define CS(k) LG(LC(k))

//#define DEF 0
#define CMK 0
#define WIN 1
#define LEF 2
#define RIG 3
#define RTW 4
#define TRI 5
#define NIR 6
#define XTR 7
#define GAM 8
#define DKT 9
#define HEX 10

ZMK_UNICODE_SINGLE(euro_sign, N2, N0, A, C)
/ {
    macros {
        g10: g10 {
            compatible = "zmk,behavior-macro";
            #binding-cells = <0>;
            bindings
                = <&macro_tap &kp N1 &kp N0 &kp TAB>
                ;
        };
        g8: g8 {
            compatible = "zmk,behavior-macro";
            #binding-cells = <0>;
            bindings
                = <&macro_tap &kp N8 &kp TAB>
                ;
        };
        g65: g65 {
            compatible = "zmk,behavior-macro";
            #binding-cells = <0>;
            bindings
                = <&macro_tap &kp N6 &kp DOT &kp N5 &kp TAB>
                ;
        };
        g55: g55 {
            compatible = "zmk,behavior-macro";
            #binding-cells = <0>;
            bindings
                = <&macro_tap &kp N5 &kp DOT &kp N5 &kp TAB>
                ;
        };
        g4: g4 {
            compatible = "zmk,behavior-macro";
            #binding-cells = <0>;
            bindings
                = <&macro_tap &kp N4 &kp TAB>
                ;
        };
        g2: g2 {
            compatible = "zmk,behavior-macro";
            #binding-cells = <0>;
            bindings
                = <&macro_tap &kp N2 &kp TAB>
                ;
        };
        g0: g0 {
            compatible = "zmk,behavior-macro";
            #binding-cells = <0>;
            bindings
                = <&macro_tap &kp N0 &kp TAB>
                ;
        };
    };
};

/ {
    behaviors {
        ht: hold_tap {
            label = "hold_tap";
            compatible = "zmk,behavior-hold-tap";
            #binding-cells = <2>;
            flavor = "tap-preferred";
            tapping-term-ms = <240>; // Down from 420
            quick-tap-ms = <150>; // Down from 150, test how this goes
            global-quick-tap;
            bindings = <&kp>, <&kp>;
        };
        td1: tap_dance1 {
            compatible = "zmk,behavior-tap-dance";
            #binding-cells = <0>;
            tapping-term-ms = <200>;
            bindings = <&kp N1>, <&kp N6>;
        };
        td2: tap_dance2 {
            compatible = "zmk,behavior-tap-dance";
            #binding-cells = <0>;
            tapping-term-ms = <200>;
            bindings = <&kp N2>, <&kp N7>;
        };
        td3: tap_dance3 {
            compatible = "zmk,behavior-tap-dance";
            #binding-cells = <0>;
            tapping-term-ms = <200>;
            bindings = <&kp N3>, <&kp N8>;
        };
        td4: tap_dance4 {
            compatible = "zmk,behavior-tap-dance";
            #binding-cells = <0>;
            tapping-term-ms = <200>;
            bindings = <&kp N4>, <&kp N9>;
        };
        td5: tap_dance5 {
            compatible = "zmk,behavior-tap-dance";
            #binding-cells = <0>;
            tapping-term-ms = <200>;
            bindings = <&kp N5>, <&kp N0>;
        };
        tdet: tap_dance_tab_esc {
            compatible = "zmk,behavior-tap-dance";
            #binding-cells = <0>;
            tapping-term-ms = <200>;
            bindings = <&kp ESC>, <&kp TAB>;
        };
    };

    conditional_layers {
        compatible = "zmk,conditional-layers";
        tri_layer {
            if-layers = <RIG LEF>;
            then-layer = <TRI>;
        };
        tri_layer_win {
            if-layers = <RTW LEF>;
            then-layer = <TRI>;
        };
    };

    keymap {
        compatible = "zmk,keymap";

        default_layer {
            bindings = <
        //╭──────────┬──────────┬──────────┬──────────┬──────────╮             ╭──────────┬──────────┬──────────┬──────────┬──────────╮
        //│  Q       │  W       │  F       │  P       │  B       │             │  J       │  L       │  U       │  Y       │ BACKSPACE│
 &kp PAGE_UP     &kp Q      &kp W      &kp F      &kp P      &kp B                    &kp J      &kp L      &kp U      &kp Y      &kp BSPC   &kp DELETE
        //├──────────┼──────────┼──────────┼──────────┼──────────┤             ├──────────┼──────────┼──────────┼──────────┼──────────┤
        //│  A       │  R       │  S       │  T       │  G       │             │  M       │  N       │  E       │  I       │ O        │
 &ESC    HRML(A,         R,         S,         T)     &kp G                    &kp M      HRMR(N,        E,           I,       O)     &kp ENTER
        //├──────────┼──────────┼──────────┼──────────┼──────────┤             ├──────────┼──────────┼──────────┼──────────┼──────────┤
        //│  Z       │  X       │  C       │  D       │  V       │             │  K       │  H       │ , <      │ . >      │ ENTER    │
 &kp PAGE_DOWN     &kp Z      &kp X      &kp C      &kp D      &kp V                    &kp K      &kp H      &kp COMMA  &kp DOT    &lt HEX ENTER  &kp K_CONTEXT_MENU
        //╰──────────┴──────────┼──────────┼──────────┼──────────┤             ├──────────┼──────────┼──────────┼──────────┴──────────╯
                                  &lt NIR ESC &lt LEF SPACE &ht LSHIFT SPACE   &ht RSHIFT SPACE &lt RIG SPACE &lt XTR TAB
        //                      ╰──────────┴──────────┴──────────╯             ╰──────────┴──────────┴──────────╯
            >;
        };


        windows_layer {
            bindings = <
        //╭──────────┬──────────┬──────────┬──────────┬──────────╮             ╭──────────┬──────────┬──────────┬──────────┬──────────╮
        //│  Q       │  W       │  E       │  R       │  T       │             │  Y       │  U       │  I       │  O       │ BACKSPACE│
 &trans     &kp Q      &kp W      &kp E      &kp R      &kp T                    &kp Y      &kp U      &kp I      &kp O      &kp BSPC   &trans
        //├──────────┼──────────┼──────────┼──────────┼──────────┤             ├──────────┼──────────┼──────────┼──────────┼──────────┤
        //│  A       │  S       │  D       │  F       │  G       │             │  H       │  J       │  K       │  L       │ ;        │
 &trans   HRML( A,         S,         D,         F)     &kp G                    &kp H      HRMR(J,        K,           L,       SEMI)  &trans
        //├──────────┼──────────┼──────────┼──────────┼──────────┤             ├──────────┼──────────┼──────────┼──────────┼──────────┤
        //│  Z       │  X       │  C       │  V       │  B       │             │  N       │  M       │ , <      │ . >      │ ENTER    │
 &trans     &kp Z      &kp X      &kp C      &kp V      &kp B                    &kp N      &kp M      &kp COMMA  &kp DOT    &kp ENTER  &trans
        //╰──────────┴──────────┼──────────┼──────────┼──────────┤             ├──────────┼──────────┼──────────┼──────────┴──────────╯
                                  &lt NIR ESC &lt LEF SPACE &ht LSHIFT SPACE   &ht RSHIFT SPACE &lt RTW SPACE &lt XTR TAB
        //                      ╰──────────┴──────────┴──────────╯             ╰──────────┴──────────┴──────────╯
            >;
        };


        left_layer {
            bindings = <
        //╭──────────┬──────────┬──────────┬──────────┬──────────╮   ╭──────────┬──────────┬──────────┬──────────┬──────────╮
//│ 1        │  2       │  3       │  4       │  5       │   │ 6        │ 7        │ 8        │ 9        │   0      │
&kp K_VOL_UP     &kp N1    &kp N2     &kp N3     &kp N4     &kp N5          &kp N6     &kp N7     &kp N8     &kp N9      &kp N0   &trans
        //├──────────┼──────────┼──────────┼──────────┼──────────┤   ├──────────┼──────────┼──────────┼──────────┼──────────┤
        //│          │          │          │          │          │   │ LEFT     │ DOWN     │ UP       │ RIGHT    │          │
 &kp K_VOL_DOWN      &kp DOT  &kp LARW   &kp UARW  &kp DARW    &kp RARW       &kp LARW   &kp DARW   &kp UARW   &kp RARW   &kp COMMA  &trans
        //├──────────┼──────────┼──────────┼──────────┼──────────┤   ├──────────┼──────────┼──────────┼──────────┼──────────┤
        //│          │          │          │          │          │   │ HOME     │ PAGE DN  │ PAGE UP  │ END      │          │
 &kp K_PP    &kp ENTER  &kp LC(V)  &kp LC(C) &kp LS(LC(TAB)) &kp LC(TAB) &kp HOME   &kp PG_DN  &kp PG_UP  &kp END    &kp INS    &trans
        //╰──────────┴──────────┼──────────┼──────────┼──────────┤   ├──────────┼──────────┼──────────┼──────────┴──────────╯
                                  &kp DEL   &trans     &trans         &trans     &trans     &kp TAB
        //                      ╰──────────┴──────────┴──────────╯   ╰──────────┴──────────┴──────────╯
            >;
        };

        right_layer {
            bindings = <
        //╭──────────┬──────────┬──────────┬──────────┬──────────╮   ╭──────────┬──────────┬──────────┬──────────┬──────────╮
        //│  !       │  @       │  #       │  $       │  %       │   │  ^       │  &       │  *       │  ~       │ BACKSPC  │
 &trans     &kp EXCL   &kp AT     &kp HASH   &kp DLLR   &kp PRCNT      &kp CARET  &kp AMPS   &kp ASTRK  &kp TILDE  &trans    &trans
        //├──────────┼──────────┼──────────┼──────────┼──────────┤   ├──────────┼──────────┼──────────┼──────────┼──────────┤
        //│  "       │  [       │  {       │  (       │          │   │   /      │  -       │  =       │     :    │  ;       │
 &trans     &kp DQT  &kp LBKT   &kp LBRC   &kp LPAR   &euro_sign         &kp FSLH   &kp MINUS  &kp EQUAL  &kp COLON   &kp SEMI &trans
        //├──────────┼──────────┼──────────┼──────────┼──────────┤   ├──────────┼──────────┼──────────┼──────────┼──────────┤
        //│  '       │  ]       │  }       │  )       │ `        │   │    \     │  _       │  +       │  │       │   ?      │
 &trans     &kp SQT     &kp RBKT   &kp RBRC   &kp RPAR  &kp GRAVE      &kp BSLH   &kp UNDER  &kp PLUS   &kp PIPE  &kp QMARK &trans
        //╰──────────┴──────────┼──────────┼──────────┼──────────┤   ├──────────┼──────────┼──────────┼──────────┴──────────╯
                                  &trans     &trans     &trans         &trans      &trans    &kp ENTER
        //                      ╰──────────┴──────────┴──────────╯   ╰──────────┴──────────┴──────────╯
            >;
        };

        right_layer_win {
            bindings = <
        //╭──────────┬──────────┬──────────┬──────────┬──────────╮   ╭──────────┬──────────┬──────────┬──────────┬──────────╮
        //│  !       │  @       │  #       │  $       │  %       │   │  ^       │  &       │  *       │  ~       │ BACKSPC  │
 &trans     &kp EXCL   &kp AT     &kp HASH   &kp DLLR   &kp PRCNT      &kp CARET  &kp AMPS   &kp ASTRK  &kp TILDE &trans     &trans
        //├──────────┼──────────┼──────────┼──────────┼──────────┤   ├──────────┼──────────┼──────────┼──────────┼──────────┤
        //│  "       │  [       │  {       │  (       │          │   │   /      │  -       │  =       │     :    │  P       │
 &trans     &kp DQT  &kp LBKT   &kp LBRC   &kp LPAR   &euro_sign         &kp FSLH   &kp MINUS  &kp EQUAL &kp LS(P) &kp P      &trans
        //├──────────┼──────────┼──────────┼──────────┼──────────┤   ├──────────┼──────────┼──────────┼──────────┼──────────┤
        //│  '       │  ]       │  }       │  )       │ `        │   │    \     │  _       │  +       │  │       │   ?      │
 &trans     &kp SQT     &kp RBKT   &kp RBRC   &kp RPAR  &kp GRAVE      &kp BSLH   &kp UNDER  &kp PLUS   &kp PIPE  &kp QMARK &trans
        //╰──────────┴──────────┼──────────┼──────────┼──────────┤   ├──────────┼──────────┼──────────┼──────────┴──────────╯
                                  &trans     &trans     &trans         &trans      &trans    &kp ENTER
        //                      ╰──────────┴──────────┴──────────╯   ╰──────────┴──────────┴──────────╯
            >;
        };

        tri_layer {
            bindings = <
        //╭──────────┬──────────┬──────────┬───────────┬────────────╮   ╭────────────┬────────────┬──────────┬───────────┬──────────╮
        //│  F1      │  F2      │  F3      │  F4       │ PROFILE 0  │   │ PROFILE 3  │ TOGGLEOUT  │          │ VOL MUTE  │ NEXTSONG │
 &trans     &kp F1     &kp F2     &kp F3     &kp F4     &bt BT_SEL 0     &bt BT_SEL 3  &out OUT_TOG &tog WIN  &kp C_MUTE  &kp C_NEXT &trans
        //├──────────┼──────────┼──────────┼───────────┼────────────┤   ├────────────┼────────────┼──────────┼───────────┼──────────┤
        //│  F5      │  F6      │  F7      │  F8       │ PROFILE 1  │   │ PROFILE 4  │ INC BRIGHT │  PrintSc │  VOL UP   │PAUSEMUSIC│
 &trans     &kp F5     &kp F6     &kp F7     &kp F8     &bt BT_SEL 1     &bt BT_SEL 4  &kp C_BRI_UP &kp PSCRN  &kp C_VOL_UP  &kp C_PP &trans
        //├──────────┼──────────┼──────────┼───────────┼────────────┤   ├────────────┼────────────┼──────────┼───────────┼──────────┤
        //│  F9      │  F10     │  F11     │  F12      │ PROFILE 2  │   │ CLEAR BT   │ DEC BRIGHT │ CAPS     |  VOL DOWN │ PREVSONG │
 &trans     &kp F9     &kp F10    &kp F11    &kp F12     &bt BT_SEL 2    &bt BT_CLR    &kp C_BRI_DEC &kp CAPS &kp C_VOL_DN &kp C_PREV &trans
        //╰──────────┴──────────┼──────────┼───────────┼────────────┤   ├────────────┼────────────┼──────────┼──────────┴──────────╯
                                  &trans     &trans     &trans           &trans        &trans       &trans
        //                      ╰──────────┴───────────┴────────────╯   ╰────────────┴────────────┴──────────╯
            >;
        };

        niri_layer {
            bindings = <
       //╭───────────┬───────────┬───────────┬───────────┬───────────╮   ╭───────────┬───────────┬───────────┬───────────┬────────────╮
       //│  Q        │  W        │  F        │  P        │  B        │   │  J        │  L        │  U        │  Y        │ BACKSPACE  │
&trans     &kp LG(N1)  &kp LG(N2)  &kp LG(N3)  &kp LG(N4)  &kp LG(N5)      &kp LG(N6)  &kp LG(L)  &kp LG(U)  &kp LG(N9)  &kp LG(N0)   &trans
       //├───────────┼───────────┼───────────┼───────────┼───────────┤   ├───────────┼───────────┼───────────┼───────────┼────────────┤
       //│  A        │  R        │  S        │  T        │  G        │   │  M        │  N        │  E        │  I        │ O          │
&trans     &kp CS(N0)  &kp CS(N1)  &kp CS(N2)  &kp LG(T)   &kp LG(R)       &kp LG(M)   &kp LG(N)   &kp LG(E)   &kp LG(I)   &kp SS(R)    &trans
       //├───────────┼───────────┼───────────┼───────────┼───────────┤   ├───────────┼───────────┼───────────┼───────────┼────────────┤
       //│  Z        │  X        │  C        │  D        │  V        │   │  K        │  H        │ , <       │ . >       │ ENTER      │
&trans     &kp LG(X)   &kp LG(C)   &kp SS(T)  &kp SS(TAB) &kp LG(TAB)     &kp SS(M)   &kp SS(N)   &kp SS(E)   &kp SS(I)   &kp LG(ENTER) &trans
       //╰───────────┴───────────┼───────────┼───────────┼───────────┤   ├───────────┼───────────┼───────────┼───────────┴────────────╯
                                  &trans       &trans     &kp LG(SPACE)   &ht RSHIFT LG(SPACE) &kp LG(EQUAL) &kp LG(MINUS)
       //                        ╰───────────┴───────────┴───────────╯   ╰───────────┴───────────┴───────────╯
            >; // LG(RCTRL) =? Naar muis layer?
            // symbol layer?
            // combining diacritics?

            // LG(RCTRL) en RALT eraf
        };

/*         hypr_layer { */
/*             bindings = < */
/*        //╭───────────┬───────────┬───────────┬───────────┬───────────╮   ╭───────────┬───────────┬───────────┬───────────┬────────────╮ */
/*        //│  Q        │  W        │  F        │  P        │  B        │   │  J        │  L        │  U        │  Y        │ BACKSPACE  │ */
/* &trans     &kp LG(N1)  &kp LG(N2)  &kp LG(N3)  &kp LG(N4)  &kp LG(N5)      &kp LG(N6)  &kp LG(L)  &kp LG(U)  &kp LG(N9)  &kp LG(N0)   &trans */
/*        //├───────────┼───────────┼───────────┼───────────┼───────────┤   ├───────────┼───────────┼───────────┼───────────┼────────────┤ */
/*        //│  A        │  R        │  S        │  T        │  G        │   │  M        │  N        │  E        │  I        │ O          │ */
/* &trans     &kp CS(N0)  &kp CS(N1)  &kp CS(N2)  &kp LG(T)   &kp LG(R)       &kp LG(M)   &kp LG(N)   &kp LG(E)   &kp LG(I)   &kp SS(R)    &trans */
/*        //├───────────┼───────────┼───────────┼───────────┼───────────┤   ├───────────┼───────────┼───────────┼───────────┼────────────┤ */
/*        //│  Z        │  X        │  C        │  D        │  V        │   │  K        │  H        │ , <       │ . >       │ ENTER      │ */
/* &trans     &kp LG(X)   &kp LG(C)   &kp SS(T)  &kp SS(TAB) &kp LG(TAB)     &kp SS(M)   &kp SS(N)   &kp SS(E)   &kp SS(I)   &kp LG(ENTER) &trans */
/*        //╰───────────┴───────────┼───────────┼───────────┼───────────┤   ├───────────┼───────────┼───────────┼───────────┴────────────╯ */
/*                                   &trans       &trans     &kp LG(SPACE)   &ht RSHIFT LG(SPACE) &kp LG(EQUAL) &kp LG(MINUS) */
/*        //                        ╰───────────┴───────────┴───────────╯   ╰───────────┴───────────┴───────────╯ */
/*             >; // LG(RCTRL) =? Naar muis layer? */
/*             // symbol layer? */
/*             // combining diacritics? */
/**/
/*             // LG(RCTRL) en RALT eraf */
/*         }; */

        extra_layer {  // movement keys on right hand triggered by right thumb
                       // rest of space for symbols / diacritics
            bindings = <
        //╭──────────┬──────────┬──────────┬──────────┬──────────╮   ╭──────────┬──────────┬──────────┬──────────┬──────────╮
        //│          │          │          │          │          │   │ RESERVE  │ FOR      │ MOUSE    │ MOVEMENT │ KEYS     │
 &trans     &trans    &trans     &trans    &trans      &trans        &mmv MOVE_LEFT &mmv MOVE_DOWN &mmv MOVE_UP &mmv MOVE_RIGHT      &mkp MB1      &trans
        //├──────────┼──────────┼──────────┼──────────┼──────────┤   ├──────────┼──────────┼──────────┼──────────┼──────────┤
        //│          │          │          │          │          │   │          │          │          │          │          │
 &trans     &trans    &trans     &trans    &trans      &trans         &kp LARW   &kp DARW   &kp UARW   &kp RARW  &mkp MB2       &trans
        //├──────────┼──────────┼──────────┼──────────┼──────────┤   ├──────────┼──────────┼──────────┼──────────┼──────────┤
        //│          │          │          │          │          │   │          │          │          │          │          │
 &trans    &trans     &trans     &trans     &tog DKT   &tog GAM      &msc SCRL_LEFT &msc SCRL_DOWN &msc SCRL_UP &msc SCRL_RIGHT      &mkp MB3      &trans
        //╰──────────┴──────────┼──────────┼──────────┼──────────┤   ├──────────┼──────────┼──────────┼──────────┴──────────╯
                                  &trans     &trans     &trans       &bootloader &trans     &trans
        //                      ╰──────────┴──────────┴──────────╯   ╰──────────┴──────────┴──────────╯
            >;
        };


        game_layer {
            bindings = <
        //╭──────────┬──────────┬──────────┬──────────┬──────────╮   ╭──────────┬──────────┬──────────┬──────────┬──────────╮
        //│          │ UP       │          │          │          │   │          │          │          │          │          │
 &trans     &kp Q      &kp W      &kp E      &kp R      &kp T        &trans    &trans     &trans    &trans      &trans      &trans
        //├──────────┼──────────┼──────────┼──────────┼──────────┤   ├──────────┼──────────┼──────────┼──────────┼──────────┤
        //│ LEFT     │ DOWN     │ RIGHT    │          │          │   │          │          │          │          │          │
 &trans     &kp A      &kp S      &kp D      &kp F      &tdet        &kp LARW  &kp DARW   &kp UARW  &kp RARW    &trans      &trans
        //├──────────┼──────────┼──────────┼──────────┼──────────┤   ├──────────┼──────────┼──────────┼──────────┼──────────┤
        //│ 1/6      │ 2/7      │ 3/8      │ 4/9      │ 5/0      │   │          │          │          │          │          │
 &trans     &td5       &td4       &td3       &td2       &td1           &trans    &trans     &trans    &trans      &tog GAM      &trans
        //╰──────────┴──────────┼──────────┼──────────┼──────────┤   ├──────────┼──────────┼──────────┼──────────┴──────────╯
                                  &kp LCTRL &kp LSHIFT &kp SPACE     &kp ENTER     &trans       &trans
        //                      ╰──────────┴──────────┴──────────╯   ╰──────────┴──────────┴──────────╯
            >;
        };

        darktable_layer {
            bindings = <
        //╭──────────┬──────────┬──────────┬──────────┬──────────╮   ╭──────────┬──────────┬──────────┬──────────┬──────────╮
        //│          │          │          │          │          │   │          │          │          │          │          │
 &trans     &kp LC(N1) &kp LC(N2) &kp LC(N3) &kp LC(N4) &kp LC(N5)     &trans     &trans     &trans     &trans     &trans      &trans
        //├──────────┼──────────┼──────────┼──────────┼──────────┤   ├──────────┼──────────┼──────────┼──────────┼──────────┤
        //│          │          │          │          │          │   │          │          │          │          │          │
 &trans     &kp N1     &kp N2     &kp N3     &kp N4     &kp N5         &trans     &trans     &trans     &trans     &trans      &trans
        //├──────────┼──────────┼──────────┼──────────┼──────────┤   ├──────────┼──────────┼──────────┼──────────┼──────────┤
        //│          │          │          │          │          │   │          │          │          │          │          │
 &trans     &kp R      &trans     &trans  &kp LC(TILDE) &kp N0         &trans     &trans     &trans      &trans     &tog DKT    &trans
        //╰──────────┴──────────┼──────────┼──────────┼──────────┤   ├──────────┼──────────┼──────────┼──────────┴──────────╯
                                  &kp D      &kp BSPC   &kp SPACE      &trans     &trans     &trans
        //                      ╰──────────┴──────────┴──────────╯   ╰──────────┴──────────┴──────────╯
            >;
        };

        hex_layer {
            bindings = <
        //╭──────────┬──────────┬──────────┬──────────┬──────────╮   ╭──────────┬──────────┬──────────┬──────────┬──────────╮
        //│          │          │          │          │          │   │          │          │          │          │          │
 &trans     &kp N1     &kp N2     &kp N3     &kp N4     &kp N5         &trans    &trans     &trans    &trans      &trans      &trans
        //├──────────┼──────────┼──────────┼──────────┼──────────┤   ├──────────┼──────────┼──────────┼──────────┼──────────┤
        //│          │          │          │          │          │   │          │          │          │          │          │
 &trans     &kp N6     &kp N7     &kp N8     &kp N9     &kp A          &trans    &trans     &trans    &trans      &trans      &trans
        //├──────────┼──────────┼──────────┼──────────┼──────────┤   ├──────────┼──────────┼──────────┼──────────┼──────────┤
        //│          │          │          │          │          │   │          │          │          │          │          │
 &trans     &kp B      &kp C      &kp D      &kp E      &kp F          &trans    &trans     &trans    &trans      &trans      &trans
        //╰──────────┴──────────┼──────────┼──────────┼──────────┤   ├──────────┼──────────┼──────────┼──────────┴──────────╯
                                  &kp HASH   &kp N0     &kp SPACE      &trans    &trans     &trans
        //                      ╰──────────┴──────────┴──────────╯   ╰──────────┴──────────┴──────────╯
            >;
        };


    };
};
